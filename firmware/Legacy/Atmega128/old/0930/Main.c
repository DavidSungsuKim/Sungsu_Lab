

#include <avr/io.h>
#include <avr/eeprom.h>
#include <avr/interrupt.h>
#include <util/delay.h> 

#define F_CPU 16000000UL
#define DEBOUNCING 40

unsigned char pattern[4] = {0x02, 0x08, 0x20, 0x80};
unsigned char segment[17] = {0x3F, 0x06, 0x5B, 0x4F, 0x66, 0x7D, 0x07,
							 0x7F, 0x6F, 0x77, 0x7C, 0x58, 0x5E, 0x79,
							 0x71, 0x00
							 };


unsigned char scanline[8] =  {0xFE, 0xFD, 0xFB, 0xF7,	// 1~8 line 선택
							  0xEF, 0xDF, 0xBF, 0x7F};

unsigned char num_left[10][8] = {{0x07, 0x05, 0x05, 0x05, 0x05, 0x05, 0x05, 0x00 },// 0
							  {0x02, 0x06, 0x02, 0x02 ,0x02, 0x02, 0x07, 0x00 }, // 1
							  {0x07, 0x01, 0x01, 0x07 ,0x04, 0x04, 0x07, 0x00 }, // 2
							  {0x07, 0x01, 0x01, 0x07 ,0x01, 0x01, 0x07, 0x00 }, // 3
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							  {0x07, 0x05, 0x05, 0x07 ,0x01, 0x01, 0x07, 0x00 }};// 9	


unsigned char num_right[8] = {0x40, 0x40, 0x40, 0x40 ,0x40, 0x40, 0x40, 0x40};
unsigned char num_temp[8] = {0xF0, 0xF0, 0xF0, 0xF0 ,0xF0, 0xF0, 0xF0, 0xF0};

void main()
{	
	initCPU();


 // PORTA = pattern[0];

	EICRA = (2<<ISC00);	// 하강엣지 트리거
//	EIMSK = (1<<INT0);	// interrupt 0 허용f
	EIMSK = (1<<INT1);	// interrupt 1 허용


  	while(1)
	{
		static int i = 0;
		static int num = 0;
		unsigned char temp;

		//===도트매트릭스구동(dynamic)=======
		PORTE = scanline[i];
	//	PORTB = ~(num_left[5][i]);
	
		// test =========
		PORTB = ~(num_right[i]);
		//===============



		i++;

		if(i == 8)
		{
			i = 0;
		
			num++;

			if(num == 10)
				num = 0;

			_delay_ms(20);
		
		}	
		_delay_ms(20);
		//===================================			
	
	};

}

void initCPU()
{
	// Port setting
    DDRA = 0xFF;	// portA를 모두 output으로 설정.
	DDRB = 0xFF;	// 도트매트릭스용.
	DDRE = 0xFF; 	// 도트매트릭스용.

	DDRD = 0x00;	// 인터럽트 스위치용.

	sei();			// 전역인터럽트 허용

	// TimerCounter0 Setting
	TCCR0 = 0x00; 	// 표준모드, 타이머정지
	TCCR0 |= 0x07;	// 분주비 셋팅(1024)
	TIMSK = 0x01;	// 인터럽트셋팅


	// TimerCounter2 Setting
//	TCCR2 = 0x40;	// Phase Correct PWM 모드, 타이머정지
//	TCCR2 |= 0x20;	// Compare Match 출력모드 설정
//	TCCR2 |= 0x03;	// 분주비 셋팅(64)	
//	OCR2 = 0;
//	TIMSK |= 0x80;	// 인터럽트셋팅 -> ※이거하면 정상적으로 동작하지 않는다. 왜 그런가?

}

